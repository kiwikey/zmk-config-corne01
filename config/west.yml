## config/west.yml
```yaml
manifest:
  remotes:
    - name: zmkfirmware
      url-base: https://github.com/zmkfirmware
    - name: kiwikey_zmkfirmware
      url-base: https://github.com/kiwikey
  projects:
    - name: zmk
      remote: kiwikey_zmkfirmware
      revision: dev_custom_workflows
      import: app/west.yml
  self:
    path: config
```
